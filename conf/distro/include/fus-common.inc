## sources/meta-fus/conf/machine/fsimx8m.conf
```bitbake
#@TYPE: Machine
#@NAME: fsimx8m
#@SOC: i.MX8M(Q)
#@DESCRIPTION: Machine configuration for F&S boards with i.MX8M(Q)
#@MAINTAINER: Anatol Derksen <derksen@fs-net.de>

MACHINEOVERRIDES =. "mx8:mx8m:mx8mq:"

require conf/machine/include/imx-base.inc
require conf/machine/include/arm/arch-arm64.inc

#UBoot
UBOOT_CONFIG ??= "sd"
UBOOT_CONFIG[sd] = "fsimx8m_defconfig"
SPL_BINARY = "spl/u-boot-spl.bin"

# Set DDR FIRMWARE
DDR_FIRMWARE_NAME = "lpddr4_pmu_train_1d_imem.bin lpddr4_pmu_train_1d_dmem.bin lpddr4_pmu_train_2d_imem.bin lpddr4_pmu_train_2d_dmem.bin"

# Set u-boot DTB
UBOOT_DTB_NAME = "armstonemx8m.dtb"

# Set imx-mkimage boot target
IMXBOOT_TARGETS = "flash_evk flash_evk_no_hdmi"

IMAGE_BOOTLOADER = "imx-boot"

BOOT_SPACE = "65536"

LOADADDR = ""
UBOOT_SUFFIX = "bin"
UBOOT_MAKE_TARGET = ""
IMX_BOOT_SEEK = "33"

#Kernel
KERNEL_IMAGETYPE = "Image"

# exclude silex wlan driver and firmware from build
PACKAGE_EXCLUDE_pn_fsimx8mm = "silex-wlanbt-fs silex-wlanbt-fs-firmware"
KERNEL_DEVICETREE  = "F+S/armstonemx8m.dtb"
KERNEL_DEVICETREE += "F+S/armstonemx8m-lcdif-sn65dsi84-g070y2-l01.dtb"
KERNEL_DEVICETREE += "F+S/armstonemx8m-lcdif-sn65dsi84-g101ice-l01.dtb"

#RootFS
SDCARD_ROOTFS ?= "${DEPLOY_DIR_IMAGE}/${IMAGE_NAME}.rootfs.ext4"
IMAGE_FSTYPES ?= "ext4 sdcard.gz"

# Sets the login console.
# You may  specify a login here with e.g
# SERIAL_CONSOLE = "115200;ttymxc1"
# but this will also always open a login at the linux debug console
# as it is systemd default.
SERIAL_CONSOLE = "FUS_LOGIN_CONSOLE"
```

## sources/meta-fus/conf/machine/fsimx8mm.conf
```bitbake
#@TYPE: Machine
#@NAME: fsimx8mm
#@SOC: i.MX8MM
#@DESCRIPTION: Machine configuration for F&S boards with i.MX8M Mini
#@MAINTAINER: Anatol Derksen <derksen@fs-net.de>

MACHINEOVERRIDES =. "mx8:mx8m:mx8mm:"

require conf/machine/include/imx-base.inc
require conf/machine/include/tune-cortexa53.inc

#UBoot
UBOOT_MACHINE="fsimx8mm_defconfig"
UBOOT_SUFFIX_mx8m = "fs"
UBOOT_BINARY_mx8m = "uboot.${UBOOT_SUFFIX}"
UBOOT_WIC_BINARY = "u-boot-dtb.img"
#IMAGE_BOOTLOADER = ""

#Kernel
KERNEL_IMAGETYPE = "Image"
KERNEL_DEVICETREE  = "F+S/picocoremx8mm-lpddr4.dtb"
KERNEL_DEVICETREE += "F+S/picocoremx8mm-lpddr4-lcdif-g050tan01.dtb"
KERNEL_DEVICETREE += "F+S/picocoremx8mm-lpddr4-lcdif-tc358764-j070wvtc0211.dtb"
KERNEL_DEVICETREE += "F+S/picocoremx8mm-lpddr4-lcdif-tc358764-g070y2-l01.dtb"
KERNEL_DEVICETREE += "F+S/picocoremx8mm-lpddr4-lcdif-adp-mipi2mipi1-ee0350et-2cp.dtb"
KERNEL_DEVICETREE += "F+S/picocoremx8mm-lpddr4-lcdif-adp-mipi2rgb.dtb"
KERNEL_DEVICETREE += "F+S/picocoremx8mmr2-lpddr4.dtb"
KERNEL_DEVICETREE += "F+S/picocoremx8mmr2-lpddr4-lcdif-g050tan01.dtb"
KERNEL_DEVICETREE += "F+S/picocoremx8mmr2-lpddr4-lcdif-tc358764-j070wvtc0211.dtb"
KERNEL_DEVICETREE += "F+S/picocoremx8mmr2-lpddr4-lcdif-tc358764-g070y2-l01.dtb"
KERNEL_DEVICETREE += "F+S/picocoremx8mmr2-lpddr4-lcdif-adp-mipi2mipi1-ee0350et-2cp.dtb"
KERNEL_DEVICETREE += "F+S/picocoremx8mmr2-lpddr4-lcdif-adp-mipi2rgb.dtb"
KERNEL_DEVICETREE += "F+S/picocoremx8mm-ddr3l.dtb"
KERNEL_DEVICETREE += "F+S/picocoremx8mm-ddr3l-lcdif-tc358775-g133han01.dtb"
KERNEL_DEVICETREE += "F+S/picocoremx8mm-ddr3l-lcdif-tc358775-j070wvtc0211.dtb"
KERNEL_DEVICETREE += "F+S/picocoremx8mm-ddr3l-lcdif-adp-mipi2lvds1-g133han01.dtb"
KERNEL_DEVICETREE += "F+S/picocoremx8mm-ddr3l-lcdif-adp-mipi2mipi1-ee0350et-2cp.dtb"
KERNEL_DEVICETREE += "F+S/picocoremx8mm-ddr3l-lcdif-adp-mipi2rgb.dtb"

#RootFS
IMAGE_FSTYPES = "ubifs ext4 wic.gz"
WKS_FILE_DEPENDS_remove_mx8 = "imx-boot"
SOC_DEFAULT_WKS_FILE_mx8 = "fus-uboot-bootpart.wks.in"
# 8MM UBoot starts for eMMC user partition at 0x0020_0000
UBOOT_OFFSET = "2048"

# Sets the login console.
# You may  specify a login here with e.g
# SERIAL_CONSOLE = "115200;ttymxc1"
# but this will also always open a login at the linux debug console
# as it is systemd default.
SERIAL_CONSOLES = "FUS_LOGIN_CONSOLE"
```

## sources/meta-fus/conf/machine/fsimx8mn.conf
```bitbake
#@TYPE: Machine
#@NAME: fsimx8mn
#@SOC: i.MX8MN
#@DESCRIPTION: Machine configuration for F&S boards with i.MX8M Mini
#@MAINTAINER: Anatol Derksen <derksen@fs-net.de>

MACHINEOVERRIDES =. "mx8:mx8m:mx8mn:"

require conf/machine/include/imx-base.inc
require conf/machine/include/arm/arch-arm64.inc

#UBoot
UBOOT_CONFIG ??= "sd"
UBOOT_CONFIG[sd] = "fsimx8mn_defconfig"
UBOOT_CONFIG[emmc] = "fsimx8mn_mmc_defconfig"
SPL_BINARY = "spl/u-boot-spl.bin"

# Set DDR FIRMWARE
DDR_FIRMWARE_NAME = "lpddr4_pmu_train_1d_imem.bin lpddr4_pmu_train_1d_dmem.bin lpddr4_pmu_train_2d_imem.bin lpddr4_pmu_train_2d_dmem.bin"

# Set u-boot DTB
UBOOT_DTB_NAME = "picocoremx8mn.dtb"

# Set imx-mkimage boot target
IMXBOOT_TARGETS = "flash_evk"

IMAGE_BOOTLOADER = "imx-boot"

BOOT_SPACE = "65536"

LOADADDR = ""
UBOOT_SUFFIX = "bin"
UBOOT_MAKE_TARGET = ""
IMX_BOOT_SEEK = "32"

#Kernel
KERNEL_IMAGETYPE = "Image"
KERNEL_DEVICETREE  = "F+S/picocoremx8mn.dtb F+S/picocoremx8mn-bbdsi.dtb"
KERNEL_DEVICETREE += "F+S/picocoremx8mn-lcdif-tc358764-j070wvtc0211.dtb"
KERNEL_DEVICETREE += "F+S/picocoremx8mn-lcdif-tc358764-g070y2-l01.dtb"

#RootFS
SDCARD_ROOTFS ?= "${DEPLOY_DIR_IMAGE}/${IMAGE_NAME}.rootfs.ext4"
IMAGE_FSTYPES ?= "ext4 sdcard.gz"

# Sets the login console.
# You may  specify a login here with e.g
# SERIAL_CONSOLE = "115200;ttymxc1"
# but this will also always open a login at the linux debug console
# as it is systemd default.
SERIAL_CONSOLES = "FUS_LOGIN_CONSOLE"
```

## sources/meta-fus/conf/machine/fsimx8mp.conf
```bitbake
#@TYPE: Machine
#@NAME: fsimx8mp
#@SOC: i.MX8MP
#@DESCRIPTION: Machine configuration for F&S boards with i.MX8M Plus
#@MAINTAINER: Anatol Derksen <derksen@fs-net.de>

MACHINEOVERRIDES =. "mx8:mx8m:mx8mp:"

require conf/machine/include/imx-base.inc
require conf/machine/include/tune-cortexa53.inc

#UBoot
UBOOT_MACHINE="fsimx8mp_defconfig"
UBOOT_SUFFIX_mx8m = "fs"
UBOOT_BINARY_mx8m = "uboot.${UBOOT_SUFFIX}"
UBOOT_WIC_BINARY = "u-boot-dtb.img"

#Kernel
KERNEL_IMAGETYPE = "Image"
KERNEL_DEVICETREE  = "F+S/picocoremx8mp.dtb"
KERNEL_DEVICETREE += "F+S/picocoremx8mp-lcdif-j070wvtc0211.dtb"
KERNEL_DEVICETREE += "F+S/picocoremx8mp-lcdif-adp-mipi2lvds1-j070wvtc0211-single-display.dtb"
KERNEL_DEVICETREE += "F+S/picocoremx8mp-lcdif-adp-mipi2mipi1-ee0350et-2cp.dtb"
KERNEL_DEVICETREE += "F+S/picocoremx8mp-lcdif-g133han01.dtb"
KERNEL_DEVICETREE += "F+S/picocoremx8mpr2.dtb"
KERNEL_DEVICETREE += "F+S/picocoremx8mpr2-lcdif-j070wvtc0211.dtb"
KERNEL_DEVICETREE += "F+S/picocoremx8mpr2-lcdif-adp-mipi2lvds1-j070wvtc0211-single-display.dtb"
KERNEL_DEVICETREE += "F+S/picocoremx8mpr2-lcdif-adp-mipi2mipi1-ee0350et-2cp.dtb"
KERNEL_DEVICETREE += "F+S/picocoremx8mpr2-lcdif-g133han01.dtb"
KERNEL_DEVICETREE += "F+S/armstonemx8mp.dtb"

#RootFS
IMAGE_FSTYPES = "ext4 wic.gz"
WKS_FILE_DEPENDS_remove_mx8 = "imx-boot"
SOC_DEFAULT_WKS_FILE_mx8 = "fus-uboot-bootpart.wks.in"
# 8M(P,N) UBoot starts for eMMC user partition at 0x0014_0000
UBOOT_OFFSET = "1280"

# Sets the login console.
# You may  specify a login here with e.g
# SERIAL_CONSOLE = "115200;ttymxc1"
# but this will also always open a login at the linux debug console
# as it is systemd default.
SERIAL_CONSOLES = "FUS_LOGIN_CONSOLE"
```

## sources/meta-fus/conf/machine/fsimx8mx-nano.conf
```bitbake
#@TYPE: Machine
#@NAME: fsimx8mx
#@SOC: i.MX8MM
#@DESCRIPTION: Machine configuration for F&S boards with i.MX8M Mini
#@MAINTAINER: Anatol Derksen <derksen@fs-net.de>

MACHINEOVERRIDES =. "mx8:mx8m:mx8mn:"

require conf/machine/include/imx-base.inc
require conf/machine/include/tune-cortexa53.inc

#UBoot
UBOOT_CONFIG ??= "emmc"
UBOOT_CONFIG[emmc] = "fsimx8mx_nano_mmc_defconfig"
SPL_BINARY = "spl/u-boot-spl.bin"

# Set DDR FIRMWARE
DDR_FIRMWARE_NAME = "ddr3_imem_1d.bin ddr3_dmem_1d.bin"

# Set u-boot DTB
UBOOT_DTB_NAME = "picocoremx8mx-nano.dtb"

# Set imx-mkimage boot target
IMXBOOT_TARGETS = "flash_ddr3l_val"

IMAGE_BOOTLOADER = "imx-boot"

BOOT_SPACE = "65536"

LOADADDR = ""
UBOOT_SUFFIX = "bin"
UBOOT_MAKE_TARGET = ""
IMX_BOOT_SEEK = "33"

#Kernel
KERNEL_IMAGETYPE = "Image"
KERNEL_DEVICETREE  = "F+S/picocoremx8mx-nano.dtb"
KERNEL_DEVICETREE += "F+S/picocoremx8mx-nano-bbdsi.dtb"
KERNEL_DEVICETREE += "F+S/picocoremx8mx-nano-lcdif-tc358764-j070wvtc0211.dtb"

#RootFS
IMAGE_FSTYPES ?= "ubifs ext4 wic.gz"

# Sets the login console.
# You may  specify a login here with e.g
# SERIAL_CONSOLE = "115200;ttymxc1"
# but this will also always open a login at the linux debug console
# as it is systemd default.
SERIAL_CONSOLES = "FUS_LOGIN_CONSOLE"
```

## sources/meta-fus/conf/machine/fsimx8mx.conf
```bitbake
#@TYPE: Machine
#@NAME: fsimx8mx
#@SOC: i.MX8MM
#@DESCRIPTION: Machine configuration for F&S boards with i.MX8M Mini
#@MAINTAINER: Anatol Derksen <derksen@fs-net.de>

MACHINEOVERRIDES =. "mx8:mx8m:mx8mm:"

require conf/machine/include/imx-base.inc
require conf/machine/include/tune-cortexa53.inc

#UBoot
UBOOT_CONFIG ??= "nand"
UBOOT_CONFIG[nand] = "fsimx8mm_defconfig"
UBOOT_CONFIG[emmc] = "fsimx8mm_mmc_defconfig"
SPL_BINARY = "spl/u-boot-spl.bin"

# Set DDR FIRMWARE
DDR_FIRMWARE_NAME = "ddr3_imem_1d.bin ddr3_dmem_1d.bin"

# Set u-boot DTB
UBOOT_DTB_NAME = "picocoremx8mx.dtb"

# Set imx-mkimage boot target
IMXBOOT_TARGETS = "flash_ddr3l_val"

IMAGE_BOOTLOADER = "imx-boot"

BOOT_SPACE = "65536"

LOADADDR = ""
UBOOT_SUFFIX = "bin"
UBOOT_MAKE_TARGET = ""
IMX_BOOT_SEEK = "33"

#Kernel
KERNEL_IMAGETYPE = "Image"
KERNEL_DEVICETREE  = "F+S/picocoremx8mx.dtb"
KERNEL_DEVICETREE += "F+S/picocoremx8mx-lcdif-tc358775-g133han01.dtb"
KERNEL_DEVICETREE += "F+S/picocoremx8mx-lcdif-tc358775-j070wvtc0211.dtb"
KERNEL_DEVICETREE += "F+S/picocoremx8mx-lcdif-adp-mipi2lvds1-g133han01.dtb"
KERNEL_DEVICETREE += "F+S/picocoremx8mx-lcdif-adp-mipi2mipi1-ee0350et-2cp.dtb"

#RootFS
IMAGE_FSTYPES ?= "ubifs ext4 wic.gz"

# Sets the login console.
# You may  specify a login here with e.g
# SERIAL_CONSOLE = "115200;ttymxc1"
# but this will also always open a login at the linux debug console
# as it is systemd default.
SERIAL_CONSOLES = "FUS_LOGIN_CONSOLE"
```

## sources/meta-fus/conf/machine/imx6q-armstonea9.conf
```bitbake
#@TYPE: Machine
#@NAME: F&S armStoneA9 Dual/Quad
#@SOC: imx6
#@DESCRIPTION: Machine configuration for F&S armStoneA9
#@MAINTAINER: Hartmut Keller <keller@fs-net.de>

UBOOT_SUFFIX ?= "nb0"
IMAGE_FSTYPES = "ubifs ext4 sdcard"

require conf/machine/include/imx-base.inc
require conf/machine/include/tune-cortexa9.inc

SOC_FAMILY = "mx6:mx6q"

PREFERRED_PROVIDER_virtual/kernel = "linux-fsimx6"
PREFERRED_PROVIDER_virtual/kernel_mx6 = "linux-fsimx6"
KERNEL_IMAGETYPE = "uImage"

PREFERRED_PROVIDER_u-boot = "u-boot-fsimx6"
PREFERRED_PROVIDER_u-boot_mx6 = "u-boot-fsimx6"
PREFERRED_PROVIDER_virtual/bootloader = "u-boot-fsimx6"
PREFERRED_PROVIDER_virtual/bootloader_mx6 = "u-boot-fsimx6"

MKUBIFS_ARGS = "-m 2048 -e 126976 -c 2048"
#MKUBIFS_ARGS = "-m 2048 -e 126976 -c 2800"

SERIAL_CONSOLE = "115200 ttymxc1"
#SERIAL_CONSOLE = "115200 ttymxc0"

KERNEL_DEVICETREE = "fsimx6q-armstonea9.dtb"

SDCARD_ROOTFS ?= "${DEPLOY_DIR_IMAGE}/${IMAGE_NAME}.rootfs.ext3"

####kann evtl weg. UBOOT_MACHINE = "fsvybrid_config"
UBOOT_CONFIG = "ubifs"
UBOOT_CONFIG[ubifs] = "fsimx6_config"
UBOOT_CONFIG[sd] = "fsimx6_config,sdcard"
UBOOT_CONFIG[mfgtool] = "fsimx6_config,mfgtool"
#UBOOT_CONFIG ??= "sd"
#UBOOT_CONFIG[sd] = "mx6dlsabresd_config,sdcard"
#UBOOT_CONFIG[mfgtool] = "mx6dlsabresd_config"
```

## sources/meta-fus/conf/machine/include/fus-common.inc
```bitbake
# Common settings for all F&S boards

UBOOT_ENTRYPOINT = "0x80800000"
UBOOT_ENTRYPOINT_mx6 = "0x10800000"
UBOOT_ENTRYPOINT_mx6sx = "0x80800000"
UBOOT_ENTRYPOINT_mx6ul = "0x80800000"

PREFERRED_PROVIDER_u-boot_mx6 = "u-boot-fus"
PREFERRED_PROVIDER_u-boot_mx6ul = "u-boot-fus"

PREFERRED_PROVIDER_virtual/bootloader_mx6 = "u-boot-fus"
PREFERRED_PROVIDER_virtual/bootloader_mx6ul = "u-boot-fus"

PREFERRED_PROVIDER_virtual/kernel_mx6 = "linux-fus"
PREFERRED_PROVIDER_virtual/kernel_mx6ul = "linux-fus"
```
