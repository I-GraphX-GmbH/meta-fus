## conf/distro/include/fus-common.inc
```bitbake
# Common settings for all F&S boards

MKUBIFS_ARGS ??= "-m 2048 -e 126976 -c 2048"

# Remove image_types_fsl because there is a awk command which search after a
# point(.) in the devicetrees. But we have 2 points in the devicetree
# picocom1.2.dtb so the awk command find the first point, so the new name is
# picocom1 instead of picocom1.2. And thats why you get an error at compile
# time. Thats why we copy the image_types_fsl and rename it as image_types_fus
# and changed the line in the original file from
# "DTS_BASE_NAME=`basename ${DTS_FILE} | awk -F "." '{print $1}'`" to
# "DTS_BASE_NAME=`basename ${DTS_FILE} | awk -F ".dtb" '{print $1}'`"
# The Original file will be find in sources/meta-fsl-arm/classes/
# image_types_fsl.bbclass
IMAGE_CLASSES:remove = "image_types_fsl"
IMAGE_CLASSES += "image_types_fus"

# need hosttools crc32 for U-Boot addfsheader.sh
HOSTTOOLS_NONFATAL:append:mx8 = " crc32"
```

## conf/machine/fsimx8mp.conf
```bitbake
#@TYPE: Machine
#@NAME: fsimx8mp
#@SOC: i.MX8MP
#@DESCRIPTION: Machine configuration for F&S boards with i.MX8M Plus
#@MAINTAINER: Anatol Derksen <derksen@fs-net.de>

MACHINEOVERRIDES =. "mx8:mx8m:mx8mp:"

require conf/machine/include/imx-base.inc
require conf/machine/include/fus-base.inc
require conf/machine/include/arm/armv8a/tune-cortexa53.inc

#UBoot
UBOOT_CONFIG ??= "emmc"
UBOOT_CONFIG[emmc] = "fsimx8mp_mmc_defconfig"
SPL_BINARY = "spl/u-boot-spl.bin"

# Set DDR FIRMWARE
DDR_FIRMWARE_NAME = "lpddr4_pmu_train_1d_dmem_202006.bin lpddr4_pmu_train_1d_imem_202006.bin lpddr4_pmu_train_2d_dmem_202006.bin lpddr4_pmu_train_2d_imem_202006.bin"

# Set u-boot DTB
UBOOT_DTB_NAME = "picocoremx8mp.dtb"

# Set imx-mkimage boot target
IMXBOOT_TARGETS = "flash_spl_uboot"

LOADADDR = ""
UBOOT_SUFFIX = "bin"
UBOOT_MAKE_TARGET = ""
IMX_BOOT_SEEK = "32"

UBOOT_SUFFIX:mx8mp-nxp-bsp = "bin"
UBOOT_BINARY:mx8mp-nxp-bsp = "u-boot.${UBOOT_SUFFIX}"
UBOOT_WIC_BINARY = "u-boot-dtb.bin"

#Kernel
KERNEL_IMAGETYPE = "Image"
KERNEL_DEVICETREE  = "F+S/picocoremx8mp.dtb"
KERNEL_DEVICETREE += "F+S/picocoremx8mp-lcdif-j070wvtc0211.dtb"
KERNEL_DEVICETREE += "F+S/picocoremx8mp-lcdif-adp-mipi2lvds1-j070wvtc0211-single-display.dtb"
KERNEL_DEVICETREE += "F+S/picocoremx8mp-lcdif-adp-mipi2mipi1-ee0350et-2cp.dtb"

#RootFS
IMAGE_FSTYPES = "ext4 wic.gz"

# Sets the login console.
# You may  specify a login here with e.g
# SERIAL_CONSOLE = "115200;ttymxc1"
# but this will also always open a login at the linux debug console
# as it is systemd default.
SERIAL_CONSOLES = "FUS_LOGIN_CONSOLE"
```

## sources/meta-f+s/conf/layer.conf
```bitbake
# We have a conf and classes directory, add to BBPATH
BBPATH .= ":${LAYERDIR}"

# We have recipes-* directories, add to BBFILES
BBFILES += "${LAYERDIR}/recipes-*/*/*.bb \
            ${LAYERDIR}/recipes-*/*/*.bbappend"

BBFILE_COLLECTIONS += "fus"
BBFILE_PATTERN_fus = "^${LAYERDIR}/"
BBFILE_PRIORITY_fus = "5"
#LAYERVERSION_fus = "1"
```

## sources/meta-f+s/conf/machine/imx6dl-armstonea9.conf
```bitbake
#@TYPE: Machine
#@NAME: F&S armStoneA9 DualLite/Solo
#@SOC: imx6
#@DESCRIPTION: Machine configuration for F&S armStoneA9
#@MAINTAINER: Hartmut Keller <keller@fs-net.de>

UBOOT_SUFFIX ?= "nb0"
IMAGE_FSTYPES ?= "ubifs ext3 sdcard"

require conf/machine/include/imx-base.inc
require conf/machine/include/tune-cortexa9.inc

SOC_FAMILY = "mx6:mx6dl"

PREFERRED_PROVIDER_virtual/kernel ?= "linux-fsimx6"
KERNEL_IMAGETYPE = "uImage"

PREFERRED_PROVIDER_u-boot = "u-boot-fsimx6"
PREFERRED_PROVIDER_virtual/bootloader = "u-boot-fsimx6"

MKUBIFS_ARGS = "-m 2048 -e 126976 -c 2048"
#MKUBIFS_ARGS = "-m 2048 -e 126976 -c 2800"

SERIAL_CONSOLE = "115200 ttymxc1"
#SERIAL_CONSOLE = "115200 ttymxc0"

KERNEL_DEVICETREE = "fsimx6dl-armstonea9.dtb"

SDCARD_ROOTFS ?= "${DEPLOY_DIR_IMAGE}/${IMAGE_NAME}.rootfs.ext3"

####kann evtl weg. UBOOT_MACHINE = "fsvybrid_config"
UBOOT_CONFIG ??= "ubifs"
UBOOT_CONFIG[ubifs] = "fsimx6dl_armstonea9_config"
UBOOT_CONFIG[sd] = "fsimx6dl_armstonea9_config,sdcard"
UBOOT_CONFIG[mfgtool] = "fsimx6dl_armstonea9_config,mfgtool"
#UBOOT_CONFIG ??= "sd"
#UBOOT_CONFIG[sd] = "mx6dlsabresd_config,sdcard"
#UBOOT_CONFIG[mfgtool] = "mx6dlsabresd_config"
```

## sources/meta-f+s/conf/machine/imx6dl-efusa9.conf
```bitbake
#@TYPE: Machine
#@NAME: F&S efusA9 Dual
#@SOC: imx6
#@DESCRIPTION: Machine configuration for F&S efusA9
#@MAINTAINER: Hartmut Keller <keller@fs-net.de>

UBOOT_SUFFIX ?= "nb0"
IMAGE_FSTYPES ?= "ubifs ext3 sdcard"

require conf/machine/include/imx-base.inc
require conf/machine/include/tune-cortexa9.inc

SOC_FAMILY = "mx6:mx6dl"

PREFERRED_PROVIDER_virtual/kernel ?= "linux-fsimx6"

PREFERRED_PROVIDER_u-boot = "u-boot-fsimx6"
PREFERRED_PROVIDER_virtual/bootloader = "u-boot-fsimx6"

MKUBIFS_ARGS = "-m 2048 -e 126976 -c 2048"
#MKUBIFS_ARGS = "-m 2048 -e 126976 -c 2800"

SERIAL_CONSOLE = "115200 ttymxc3"
#SERIAL_CONSOLE = "115200 ttymxc0"

KERNEL_DEVICETREE = "imx6dl-efusa9.dtb"

SDCARD_ROOTFS ?= "${DEPLOY_DIR_IMAGE}/${IMAGE_NAME}.rootfs.ext3"

####kann evtl weg. UBOOT_MACHINE = "fsvybrid_config"
UBOOT_CONFIG ??= "ubifs"
UBOOT_CONFIG[ubifs] = "fsimx6dl_efusa9_config"
UBOOT_CONFIG[sd] = "fsimx6dl_efusa9_config,sdcard"
UBOOT_CONFIG[mfgtool] = "fsimx6dl_efusa9_config,mfgtool"
#UBOOT_CONFIG ??= "sd"
#UBOOT_CONFIG[sd] = "mx6dlsabresd_config,sdcard"
#UBOOT_CONFIG[mfgtool] = "mx6dlsabresd_config"
```

## sources/meta-f+s/conf/machine/imx6sx-efusa9x.conf
```bitbake
#@TYPE: Machine
#@NAME: F&S efusA9X SoloX
#@SOC: imx6
#@DESCRIPTION: Machine configuration for F&S efusA9X
#@MAINTAINER: Hartmut Keller <keller@fs-net.de>

UBOOT_SUFFIX ?= "nb0"
IMAGE_FSTYPES ?= "ubifs ext3 sdcard"

require conf/machine/include/imx-base.inc
require conf/machine/include/tune-cortexa9.inc

SOC_FAMILY = "mx6:mx6sx"

PREFERRED_PROVIDER_virtual/kernel ?= "linux-fsimx6sx"

PREFERRED_PROVIDER_u-boot = "u-boot-fsimx6sx"
PREFERRED_PROVIDER_virtual/bootloader = "u-boot-fsimx6sx"

MKUBIFS_ARGS = "-m 2048 -e 126976 -c 2048"
#MKUBIFS_ARGS = "-m 2048 -e 126976 -c 2800"

#SERIAL_CONSOLE = "115200 ttymxc3"
SERIAL_CONSOLE = "115200 ttymxc0"

KERNEL_DEVICETREE = "fsimx6sx-efusa9x.dtb"

SDCARD_ROOTFS ?= "${DEPLOY_DIR_IMAGE}/${IMAGE_NAME}.rootfs.ext3"

####kann evtl weg. UBOOT_MACHINE = "fsvybrid_config"
UBOOT_CONFIG ??= "ubifs"
UBOOT_CONFIG[ubifs] = "fsimx6sx_config"
UBOOT_CONFIG[sd] = "fsimx6sx_config,sdcard"
UBOOT_CONFIG[mfgtool] = "fsimx6sx_config,mfgtool"
#UBOOT_CONFIG ??= "sd"
#UBOOT_CONFIG[sd] = "mx6dlsabresd_config,sdcard"
#UBOOT_CONFIG[mfgtool] = "mx6dlsabresd_config"
```

## sources/meta-fus/conf/distro/include/fus-common.inc
```bitbake
# Common settings for all F&S boards

UBOOT_ENTRYPOINT = "0x80800000"
UBOOT_ENTRYPOINT_mx6 = "0x10800000"
UBOOT_ENTRYPOINT_mx6sx = "0x80800000"
UBOOT_ENTRYPOINT_mx6ul = "0x80800000"
UBOOT_ENTRYPOINT_mx7ulp = "0x60800000"
UBOOT_ENTRYPOINT_mx8mm = "0x40008000"
UBOOT_ENTRYPOINT_mx8m = "0x40008000"
UBOOT_ENTRYPOINT_mx8mn = "0x40008000"
UBOOT_ENTRYPOINT_mx8mp = "0x40008000"

PREFERRED_PROVIDER_u-boot_mx6 = "u-boot-fus"
PREFERRED_PROVIDER_u-boot_mx6ul = "u-boot-fus"
PREFERRED_PROVIDER_u-boot_mx6sx = "u-boot-fus"
PREFERRED_PROVIDER_u-boot_mx7ulp = "u-boot-fsimx7ulp"
PREFERRED_PROVIDER_u-boot_mx8mm = "u-boot-fus"
PREFERRED_PROVIDER_u-boot_mx8m = "u-boot-fus"
PREFERRED_PROVIDER_u-boot_mx8mn = "u-boot-fus"
PREFERRED_PROVIDER_u-boot_mx8mp = "u-boot-fsimx8mp"

PREFERRED_PROVIDER_virtual/bootloader_mx6 = "u-boot-fus"
PREFERRED_PROVIDER_virtual/bootloader_mx6ul = "u-boot-fus"
PREFERRED_PROVIDER_virtual/bootloader_mx6sx = "u-boot-fus"
PREFERRED_PROVIDER_virtual/bootloader_mx7ulp = "u-boot-fsimx7ulp"
PREFERRED_PROVIDER_virtual/bootloader_mx8mm = "u-boot-fus"
PREFERRED_PROVIDER_virtual/bootloader_mx8m = "u-boot-fus"
PREFERRED_PROVIDER_virtual/bootloader_mx8mn = "u-boot-fus"
PREFERRED_PROVIDER_virtual/bootloader_mx8mp = "u-boot-fsimx8mp"

PREFERRED_PROVIDER_virtual/kernel_mx6 = "linux-fus"
PREFERRED_PROVIDER_virtual/kernel_mx6ul = "linux-fus"
PREFERRED_PROVIDER_virtual/kernel_mx6sx = "linux-fus"
PREFERRED_PROVIDER_virtual/kernel_mx7ulp = "linux-fus"
PREFERRED_PROVIDER_virtual/kernel_mx8mm = "linux-fus"
PREFERRED_PROVIDER_virtual/kernel_mx8m = "linux-fus"
PREFERRED_PROVIDER_virtual/kernel_mx8mn = "linux-fus"
PREFERRED_PROVIDER_virtual/kernel_mx8mp = "linux-fus"

IMAGE_FSTYPES_mx7ulp  = "sdcard"

MKUBIFS_ARGS ??= "-m 2048 -e 126976 -c 2048"

# Remove image_types_fsl because there is a awk command which search after a
# point(.) in the devicetrees. But we have 2 points in the devicetree
# picocom1.2.dtb so the awk command find the first point, so the new name is
# picocom1 instead of picocom1.2. And thats why you get an error at compile
# time. Thats why we copy the image_types_fsl and rename it as image_types_fus
# and changed the line in the original file from
# "DTS_BASE_NAME=`basename ${DTS_FILE} | awk -F "." '{print $1}'`" to
# "DTS_BASE_NAME=`basename ${DTS_FILE} | awk -F ".dtb" '{print $1}'`"
# The Original file will be find in sources/meta-fsl-arm/classes/
# image_types_fsl.bbclass
IMAGE_CLASSES_remove = "image_types_fsl"
IMAGE_CLASSES += "image_types_fus"

# necessary, will be set in fsl-imx-preferred-env.inc
UBOOT_SUFFIX = "nb0"
UBOOT_BINARY = "uboot.${UBOOT_SUFFIX}"
UBOOT_WIC_BINARY = "u-boot-dtb.img"
# need hosttools crc32 for U-Boot addfsheader.sh
HOSTTOOLS_NONFATAL_append_mx8m = " crc32"

DISTRO_NAME = "F&S i.MX Release Distro"
SANITY_TESTED_DISTROS += "fedora-27"
```

## sources/meta-fus/conf/machine/fsimx6.conf
```bitbake
#@TYPE: Machine
#@NAME: fsimx6
#@SOC: i.MX6
#@DESCRIPTION: Machine configuration for F&S boards with i.MX6 DualLite/Solo/Dual/Quad
#@MAINTAINER: Hartmut Keller <keller@fs-net.de>

MACHINEOVERRIDES =. "mx6:mx6dl:mx6q:"

UBOOT_SUFFIX ?= "nb0"

include conf/machine/include/imx-base.inc
include conf/machine/include/tune-cortexa9.inc

#UBoot
UBOOT_MACHINE = "fsimx6_config"

#Kernel
KERNEL_IMAGETYPE = "zImage"
KERNEL_DEVICETREE = "armstonea9dl.dtb armstonea9q.dtb armstonea9r2dl.dtb armstonea9r2q.dtb efusa9dl.dtb efusa9q.dtb picomoda9dl.dtb picomoda9q.dtb netdcua9dl.dtb netdcua9q.dtb qblissa9dl.dtb qblissa9q.dtb qblissa9r2dl.dtb qblissa9r2q.dtb"

#RootFS
SDCARD_ROOTFS ?= "${DEPLOY_DIR_IMAGE}/${IMAGE_NAME}.rootfs.ext4"

# Sets the login console.
# Setting FUS_LOGIN_CONSOLE automatically opens a login at
# the tty defined in the uboot environment variable "login"
# You may also specify a login here with e.g
# SERIAL_CONSOLE = "115200 ttymxc1"
# but this will also always open a login at the linux debug console
# as it is systemd default.
SERIAL_CONSOLES = "FUS_LOGIN_CONSOLE"
```

## sources/meta-fus/conf/machine/fsimx6q.conf
```bitbake
#@TYPE: Machine
#@NAME: fsimx6q
#@SOC: i.MX6
#@DESCRIPTION: Machine configuration for F&S boards with i.MX6 Quad/Dual
#@MAINTAINER: Hartmut Keller <keller@fs-net.de>

UBOOT_SUFFIX ?= "nb0"
IMAGE_FSTYPES ?= "ubifs ext3 sdcard"

require conf/machine/include/imx-base.inc
require conf/machine/include/tune-cortexa9.inc
include conf/machine/include/fus-common.inc

SOC_FAMILY = "mx6:mx6q"

# Preferred providers for kernel and u-boot are overwritten from the file
# fsl-imx-preferred-env.inc that is loaded later. So we defined our own
# file in meta-fus/distro/include that overtrumps NXP's default in
# meta-fsl-bsp-release/imx/meta-sdk/conf/distro/include.
#PREFERRED_PROVIDER_virtual/kernel_mx6 ?= "linux-fus"
#PREFERRED_PROVIDER_u-boot_mx6 = "u-boot-fus"
#PREFERRED_PROVIDER_virtual/bootloader_mx6 = "u-boot-fus"

KERNEL_IMAGETYPE = "uImage"

MKUBIFS_ARGS = "-m 2048 -e 126976 -c 2048"

### TODO: set to login-tty
SERIAL_CONSOLE = "115200 ttymxc1"
#SERIAL_CONSOLE = "115200 ttymxc0"

KERNEL_DEVICETREE = "armstonea9q.dtb armstonea9r2q.dtb efusa9q.dtb picomoda9q.dtb"

SDCARD_ROOTFS ?= "${DEPLOY_DIR_IMAGE}/${IMAGE_NAME}.rootfs.ext3"

UBOOT_CONFIG ??= "ubifs"
UBOOT_CONFIG[ubifs] = "fsimx6_config"
UBOOT_CONFIG[sd] = "fsimx6_config,sdcard"
UBOOT_CONFIG[mfgtool] = "fsimx6_config,mfgtool"
```

## sources/meta-fus/conf/machine/fsimx6sx.conf
```bitbake
#@TYPE: Machine
#@NAME: fsimx6sx
#@SOC: i.MX6SX
#@DESCRIPTION: Machine configuration for F&S boards with i.MX6 SoloX
#@MAINTAINER: Hartmut Keller <keller@fs-net.de>

MACHINEOVERRIDES =. "mx6:mx6sx:"

UBOOT_SUFFIX ?= "nb0"

include conf/machine/include/imx-base.inc
include conf/machine/include/tune-cortexa9.inc

#UBoot
UBOOT_MACHINE = "fsimx6sx_config"

#Kernel
KERNEL_IMAGETYPE = "zImage"
KERNEL_DEVICETREE = "efusa9x.dtb picocoma9x.dtb cont1.dtb picocoremx6sx.dtb"

#RootFS
SDCARD_ROOTFS ?= "${DEPLOY_DIR_IMAGE}/${IMAGE_NAME}.rootfs.ext4"

### TODO: set to login-tty
SERIAL_CONSOLE = "115200 ttymxc0"

# Add WIFI driver
MACHINE_ESSENTIAL_EXTRA_RRECOMMENDS += "silex-wlanbt-fs-firmware"
MACHINE_ESSENTIAL_EXTRA_RRECOMMENDS += "silex-wlanbt-fs"
```

## sources/meta-fus/conf/machine/fsimx6ul.conf
```bitbake
#@TYPE: Machine
#@NAME: fsimx6ul
#@SOC: i.MX6UL/i.MX6ULL
#@DESCRIPTION: Machine configuration for F&S boards with i.MX6 UltraLite and i.MX6ULL
#@MAINTAINER: Hartmut Keller <keller@fs-net.de>

MACHINEOVERRIDES =. "mx6:mx6ul:mx6ull:"

UBOOT_SUFFIX ?= "nb0"

include conf/machine/include/imx-base.inc
include conf/machine/include/tune-cortexa7.inc

#UBoot
UBOOT_MACHINE = "fsimx6ul_config"

#Kernel
KERNEL_IMAGETYPE = "zImage"
KERNEL_DEVICETREE = "efusa7ul.dtb efusa7ull.dtb picocom1.2.dtb gar1.dtb picocoremx6ull.dtb"

#RootFS
#SDCARD_ROOTFS ?= "${DEPLOY_DIR_IMAGE}/${IMAGE_NAME}.rootfs.ext4"

### TODO: set to login-tty
SERIAL_CONSOLE = "115200 ttymxc0"

# Add WIFI driver
MACHINE_ESSENTIAL_EXTRA_RRECOMMENDS += "silex-wlanbt-fs-firmware"
MACHINE_ESSENTIAL_EXTRA_RRECOMMENDS += "silex-wlanbt-fs"

# Mask imx-weston because it needs a GPU. The poky-weston version 2.0.0 is used instaed.
BBMASK += "/meta-fsl-bsp-release/imx/meta-bsp/recipes-graphics/wayland/weston_3.0.0.bb"
BBMASK += "/meta-fsl-bsp-release/imx/meta-bsp/recipes-graphics/wayland/weston_3.0.0.bbappend"

# end of imx6ul-common.inc
```

## sources/meta-fus/conf/machine/fsimx7ulp.conf
```bitbake
#@TYPE: Machine
#@NAME: fsimx7ulp
#@SOC: i.MX7ULP
#@DESCRIPTION: Machine configuration for F&S boards with i.MX7 Ultra Low Power
#@MAINTAINER: Hartmut Keller <keller@fs-net.de>

MACHINEOVERRIDES =. "mx7:mx7ulp:"

UBOOT_SUFFIX ?= "imx"
IMAGE_FSTYPES ?= "ext3 ext4 sdcard"

include conf/machine/include/imx-base.inc
include conf/machine/include/tune-cortexa7.inc

MACHINE_SOCARCH_SUFFIX = "-mx7ulp"
MACHINE_SOCARCH_FILTER_append_mx7ulp = "virtual/libopenvg virtual/libgles1 virtual/libgles2 virtual/egl virtual/mesa virtual/libgl virtual/libg2d"

#UBoot
UBOOT_MACHINE = "fsimx7ulp_config"

#Kernel
KERNEL_IMAGETYPE = "zImage"
KERNEL_DEVICETREE = "picocoremx7ulp.dtb"

#RootFS
SDCARD_ROOTFS ?= "${DEPLOY_DIR_IMAGE}/${IMAGE_NAME}.rootfs.ext4"

# Sets the login console.
# You may  specify a login here with e.g
# SERIAL_CONSOLE = "115200 ttyLP0"
# but this will also always open a login at the linux debug console
# as it is systemd default.
SERIAL_CONSOLE = "FUS_LOGIN_CONSOLE"

PREFERRED_PROVIDER_virtual/libgl_mx7ulp ?= "imx-gpu-viv"
PREFERRED_PROVIDER_virtual/libgles2_mx7ulp ?= "imx-gpu-viv"
PREFERRED_PROVIDER_virtual/libgles1_mx7ulp ?= "imx-gpu-viv"
MACHINE_GSTREAMER_1_0_PLUGIN_mx7ulp = "imx-gst1.0-plugin"
PREFERRED_PROVIDER_virtual/libgles1_mx7ulp ?= "imx-gpu-viv"

MACHINE_FEATURES += "wlan-sd8997 "
```
